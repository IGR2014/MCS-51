ORG 0000H
	SJMP START              ; Початок програми

ORG 0030H

START: 
    MOV P1, #0FFH           ; Налаштування порту P1 як вхідного
    MOV TMOD, #20H          ; Налаштування таймера 1 в режимі 2 (8-бітний авторелод)
    MOV TH1, #0FDH          ; Значення для генерації швидкості 9600 біт/сек при 11.0592 MHz
    MOV SCON, #50H          ; Налаштування серійного порту в режим 1 (8-бітний UART)
    SETB TR1                ; Запуск таймера 1
MAIN_LOOP:
    MOV A, P1               ; Зчитування значення з порту P1
    ANL A, #0FH             ; Маскування, щоб залишити тільки молодші 4 біти
CHECK_3:
    CJNE A, #03H, CHECK_4   ; Перевірка, якщо значення 3
    MOV A, #'3'             ; Перетворення на символ '3'
    SJMP SEND               ; Перехід до відправки
CHECK_4:
    CJNE A, #04H, CHECK_5   ; Перевірка, якщо значення 4
    MOV A, #'4'             ; Перетворення на символ '4'
    SJMP SEND               ; Перехід до відправки
CHECK_5:
    CJNE A, #05H, CHECK_6   ; Перевірка, якщо значення 5
    MOV A, #'5'             ; Перетворення на символ '5'
    SJMP SEND               ; Перехід до відправки
CHECK_6:
    CJNE A, #06H, CHECK_7   ; Перевірка, якщо значення 6
    MOV A, #'6'             ; Перетворення на символ '6'
    SJMP SEND               ; Перехід до відправки
CHECK_7:
    CJNE A, #07H, CHECK_8   ; Перевірка, якщо значення 7
    MOV A, #'7'             ; Перетворення на символ '7'
    SJMP SEND               ; Перехід до відправки
CHECK_8:
    CJNE A, #08H, CHECK_9   ; Перевірка, якщо значення 8
    MOV A, #'8'             ; Перетворення на символ '8'
    SJMP SEND               ; Перехід до відправки
CHECK_9:
    CJNE A, #09H, CHECK_A   ; Перевірка, якщо значення 9
    MOV A, #'9'             ; Перетворення на символ '9'
    SJMP SEND               ; Перехід до відправки
CHECK_A:
    CJNE A, #0AH, CHECK_B   ; Перевірка, якщо значення A
    MOV A, #'A'             ; Перетворення на символ 'A'
    SJMP SEND               ; Перехід до відправки
CHECK_B:
    CJNE A, #0BH, CHECK_C   ; Перевірка, якщо значення B
    MOV A, #'B'             ; Перетворення на символ 'B'
    SJMP SEND               ; Перехід до відправки
CHECK_C:
    CJNE A, #0CH, CHECK_D   ; Перевірка, якщо значення C
    MOV A, #'C'             ; Перетворення на символ 'C'
    SJMP SEND               ; Перехід до відправки
CHECK_D:
    CJNE A, #0DH, MAIN_LOOP ; Перевірка, якщо значення D
    MOV A, #'D'             ; Перетворення на символ 'D'
    SJMP SEND               ; Перехід до відправки
SEND:
    MOV SBUF, A             ; Відправка символу в SBUF
WAIT_TX:
    JNB TI, WAIT_TX         ; Очікування завершення передачі
    CLR TI                  ; Скидання прапору TI
    SJMP MAIN_LOOP          ; Повернення в головний цикл

END