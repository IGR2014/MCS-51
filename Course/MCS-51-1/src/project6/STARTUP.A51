ORG 0x0000
	SJMP MAIN

ORG 0x0013
    LJMP INT1_ISR       ; перехід до обробника переривань INT1

; Початок програми
MAIN:
	MOV IE, #10000100B  ; дозволити глобальні переривання та переривання від INT1
	MOV TMOD, #0x20     ; встановити таймер 1 в режим 2 (8-бітний автоперезавантаження)
	MOV TH1, #253       ; встановити швидкість передачі 9600 бод
	MOV SCON, #0x50     ; 8-бітний UART, режим 1
	SETB TR1            ; запустити таймер 1
	MOV R0, #0x00       ; лічильник натискань, початкове значення 0
    ; Кінець програми
    SJMP $  ; Бескінечний цикл для завершення програми

; Обробник переривань INT1
INT1_ISR:
    INC R0              ; збільшити лічильник натискань
    ACALL SEND_COUNT    ; викликати підпрограму для відправки лічильника
    RETI                ; завершити обробку переривання

; Підпрограма для відправки лічильника через UART
SEND_COUNT:
    MOV A, R0           ; завантажити значення лічильника в акумулятор
    ADD A, #48          ; перетворити в ASCII (якщо лічильник < 10)
    MOV SBUF, A         ; відправити значення через UART
WAIT_TX:
    JNB TI, WAIT_TX     ; чекати закінчення передачі
    CLR TI              ; скинути прапор передачі
    RET                 ; повернутися з підпрограми

END